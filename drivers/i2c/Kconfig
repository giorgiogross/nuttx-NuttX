## drivers/i2c/Kconfig
```kconfig
#
# For a description of the syntax of this configuration file,
# see the file kconfig-language.txt in the NuttX tools repository.
#

if I2C

config I2C_SLAVE
	bool "I2C Slave"
	default n

config I2C_POLLED
	bool "Polled I2C (no interrupts)"
	default n

config I2C_RESET
	bool "Support I2C reset interface method"
	default n
	depends on ARCH_HAVE_I2CRESET

config I2C_TRACE
	bool "Enable I2C trace debug"
	default n

config I2C_NTRACE
	int "Number of I2C trace records"
	default 32
	depends on I2C_TRACE

config I2C_DRIVER
	bool "I2C character driver"
	default n
	---help---
		Build in support for a character driver at /dev/i2c[N] that may be
		used to perform I2C bus transfers from applications.  The intent of
		this driver is to support I2C testing.  It is not suitable for use
		in any real driver application.

menu "I2C Multiplexer Support"

config I2CMULTIPLEXER
	bool "Enable I2C Multiplexer Support"
	default n
	---help---
		This directory holds implementations of I2C multiplexer drivers.
		See include/nuttx/i2c/i2cmultiplexer.h for registration information.

if I2CMULTIPLEXER

config I2CMUX_LOWER_HALF
	bool "I2C Multiplexer Lower Half"
	default y
	depends on I2C && I2C_DRIVER && I2CMULTIPLEXER
	---help---
		Enable support for a lower half driver that provides common i2c multiplexer
		driver support for i2c multiplexer devices.

# put common config setting here

endif # I2CMULTIPLEXER

endmenu # I2C Multiplexer Support

endif # I2C
```

## drivers/wireless/ieee802154/Kconfig
```kconfig
#
# For a description of the syntax of this configuration file,
# see the file kconfig-language.txt in the NuttX tools repository.
#

if DRIVERS_IEEE802154

config IEEE802154_MRF24J40
	bool "Microchip MRF24J40 IEEE 802.15.4 transceiver"
	default n
	---help---
		This selection enables support for the Microchip MRF24J40 device.

source drivers/wireless/ieee802154/mrf24j40/Kconfig

config IEEE802154_AT86RF233
	bool "ATMEL RF233 IEEE 802.15.4 transceiver"
	default n
	---help---
		This selection enables support for the Atmel RF233 device.

source drivers/wireless/ieee802154/at86rf23x/Kconfig

config IEEE802154_SPIRIT1
	bool "STMicro Spirit1-based transceiver module"
	default n
	select WL_SPIRIT
	---help---
		This selection enables support for the TMicro Spirit1-based device.

source drivers/wireless/ieee802154/spirit1/Kconfig

endif # DRIVERS_IEEE802154
```

## drivers/wireless/spirit/Kconfig
```kconfig
#
# For a description of the syntax of this configuration file,
# see the file kconfig-language.txt in the NuttX tools repository.
#

config WL_SPIRIT
	bool "STMicro Spririt Radio Library"
	default n
	select SPI
	---help---
		Enable support for the STMicro Spririt Radio Library

if WL_SPIRIT

endif
```
